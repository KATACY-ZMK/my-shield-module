## boards/shields/ZaruBall/Kconfig.defconfig
```kconfig
if SHIELD_ZARUBALL_RIGHT

config ZMK_KEYBOARD_NAME
    default "ZaruBall_right"

config ZMK_SPLIT
    default y

# config ZMK_SPLIT_ROLE_CENTRAL  <-- 削除
#    default y                 <-- 削除

endif

if SHIELD_ZARUBALL_LEFT

config ZMK_KEYBOARD_NAME
    default "ZaruBall_left"

config ZMK_SPLIT
    default y

endif

if SHIELD_ZARUBALL_FOOT

config ZMK_KEYBOARD_NAME
    default "ZaruBall_foot"

config ZMK_SPLIT
    default y

config ZMK_SPLIT_ROLE_CENTRAL  # <-- これを追加
    default y                # <-- これを追加

endif
```

## config/west.yml
```yaml
# manifest:
#   remotes:
#     - name: zmkfirmware
#       url-base: https://github.com/petejohanson
#     - name: inorichi
#       url-base: https://github.com/inorichi
#   projects:
#     - name: zmk
#       remote: zmkfirmware
#       revision: feat/pointers-move-scroll
#       import: app/west.yml
#     - name: zmk-pmw3610-driver
#       remote: inorichi
#       revision: main
#   self:
#     path: config

#defaultの設定
manifest:
  remotes:
    - name: zmkfirmware
      url-base: https://github.com/petejohanson  # <-- ZMKの取得元を古いバージョンがある場所に変更
    - name: inorichi
      url-base: https://github.com/inorichi
    # 他のリモート（caksoylarなど）も必要に応じてここに追加
    - name: caksoylar
      url-base: https://github.com/caksoylar
  projects:
    - name: zmk
      remote: zmkfirmware # 上記のpetejohansonのリモートを指します
      revision: feat/pointers-move-scroll # <-- ZMKのバージョンをドライバー対応版に固定
      import: app/west.yml
    - name: zmk-pmw3610-driver
      remote: inorichi
      revision: main
    # 他のモジュール（zmk-rgbled-widgetなど）もここに追加
    - name: zmk-rgbled-widget
      remote: caksoylar
      revision: main
  self:
    path: config
```
