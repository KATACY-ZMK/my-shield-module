#include "ZaruBall.dtsi"

&default_transform {
    col-offset = <13>;
};
&kscan0 {
    col-gpios = 
        <&xiao_d 10 GPIO_ACTIVE_HIGH>,
        <&xiao_d 9 GPIO_ACTIVE_HIGH>
};

&left_encoder {
    status = "okay";
};
